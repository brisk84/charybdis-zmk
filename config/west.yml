## config/west.yml
```yaml
manifest:
  remotes:
    - name: zmkfirmware
      url-base: https://github.com/petejohanson
    - name: brisk84
      url-base: https://github.com/brisk84
  projects:
    - name: zmk
      remote: zmkfirmware
      revision: feat/pointers-move-scroll
      import: app/west.yml
    - name: zmk-pmw3610-driver
      remote: brisk84
      revision: 6e26ff7209be456696c8f69d7ad3d5b495746fa2
  self:
    path: config
```
